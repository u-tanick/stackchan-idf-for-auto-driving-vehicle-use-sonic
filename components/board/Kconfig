## components/board/Kconfig
```kconfig
# Board-level Kconfig: camera enablement + GC0308 DVP pin overrides.
#
# Camera support is OFF by default. Enable it only for board variants that
# physically ship the GC0308 — currently the M5Stack CoreS3 main module. The
# atoms3r firmware MUST leave this off so it can build without pulling in
# the esp32-camera managed component.

menu "Stack-chan board"

    config STACKCHAN_CAMERA_ENABLED
        bool "Enable GC0308 DVP camera driver (CoreS3 only)"
        default n
        help
            Compile the components/board/camera_gc0308.cpp wrapper and link
            espressif/esp32-camera. Set to "y" for CoreS3 builds (see
            sdkconfig.defaults.cores3) and leave at "n" for AtomS3R — the
            AtomS3R targets do not carry a GC0308 and trying to init the
            sensor at boot would hang on a missing I2C ACK from 0x21.

    if STACKCHAN_CAMERA_ENABLED

        comment "GC0308 DVP pinmap (CoreS3 mainboard defaults)"

        config STACKCHAN_CAMERA_PIN_PCLK
            int "PCLK GPIO"
            default 45

        config STACKCHAN_CAMERA_PIN_VSYNC
            int "VSYNC GPIO"
            default 46

        config STACKCHAN_CAMERA_PIN_HREF
            int "HREF GPIO"
            default 38

        config STACKCHAN_CAMERA_PIN_SIOD
            int "SIOD (SCCB SDA) GPIO"
            default 12
            help
                Shared with the internal M5Unified I2C SDA — esp32-camera owns
                SCCB independently of m5::In_I2C.

        config STACKCHAN_CAMERA_PIN_SIOC
            int "SIOC (SCCB SCL) GPIO"
            default 11

        config STACKCHAN_CAMERA_PIN_D0
            int "D0 (Y2) GPIO"
            default 39
        config STACKCHAN_CAMERA_PIN_D1
            int "D1 (Y3) GPIO"
            default 40
        config STACKCHAN_CAMERA_PIN_D2
            int "D2 (Y4) GPIO"
            default 41
        config STACKCHAN_CAMERA_PIN_D3
            int "D3 (Y5) GPIO"
            default 42
        config STACKCHAN_CAMERA_PIN_D4
            int "D4 (Y6) GPIO"
            default 15
        config STACKCHAN_CAMERA_PIN_D5
            int "D5 (Y7) GPIO"
            default 16
        config STACKCHAN_CAMERA_PIN_D6
            int "D6 (Y8) GPIO"
            default 48
        config STACKCHAN_CAMERA_PIN_D7
            int "D7 (Y9) GPIO"
            default 47

    endif # STACKCHAN_CAMERA_ENABLED

endmenu
```

## components/telegram/Kconfig
```kconfig
# Phase 1 only: hardcoded bot token + chat-id via Kconfig. Replace with NVS-
# backed runtime config (DeviceConfig::telegram_token / telegram_chat_id) in
# Phase 4 — at which point this Kconfig surface goes away.
menu "Telegram Bot (Stack-chan)"

    config TELEGRAM_PHASE1_ENABLED
        bool "Enable Phase 1 one-shot getUpdates probe"
        default n
        help
            When enabled, app_main spawns a one-shot task that connects to
            api.telegram.org over HTTPS and calls getUpdates once with a 5 s
            timeout, then logs whatever JSON comes back. Used only during
            initial bring-up. Set to "n" once the NVS-backed integration
            (Phase 4) lands.

    config TELEGRAM_PHASE1_BOT_TOKEN
        string "Bot token (Phase 1 hard-coded)"
        default ""
        depends on TELEGRAM_PHASE1_ENABLED
        help
            Bot token issued by @BotFather, in the form "<digits>:<letters>".
            Lives only in sdkconfig.defaults.local — never commit it. Empty
            string disables the probe even if TELEGRAM_PHASE1_ENABLED is set.

endmenu
```

## components/wifi_config_service/Kconfig
```kconfig
# Phase 1 only — Kconfig-supplied bearer token for the /mcp/* HTTP endpoints
# (Claude Code Channel adapter target). Phase 2+ will move this to NVS so it's
# configurable from the BLE / Wi-Fi settings pages without a re-flash; this
# Kconfig knob then goes away.
menu "Stack-chan Channel API (Claude Code)"

    config MCP_API_TOKEN
        string "Bearer token for /mcp/* endpoints (Phase 1)"
        default ""
        help
            Static bearer token that the Channel adapter sends in the
            `Authorization: Bearer <token>` header of every /mcp/* request.
            Empty string disables the endpoints entirely (they return 404 so
            Cloudflare Tunnel can be left wired without exposing a live API).
            Put the real value in sdkconfig.defaults.local, NOT in the
            committed sdkconfig.defaults — the token is the only thing
            protecting the API from anyone who reaches the tunnel.

endmenu
```

## main/Kconfig.projbuild
```kconfig
# Project-build-level Kconfig for stackchan-idf main.
#
# Currently only the Phase 1+2 QR scanner test trigger lives here. Once Phase
# 3 lands (device_ui タブから start_qr_scan を呼ぶ) this entry will be removed
# — it's only a temporary boot-time switch for bring-up.

menu "Stack-chan QR scanner (Phase 1+2 test)"

    config STACKCHAN_QR_TEST_AT_BOOT
        bool "Auto-start QR scan ~30 s after boot"
        default n
        depends on STACKCHAN_CAMERA_ENABLED
        help
            Phase 1/2 bring-up only. With this set, app_main spawns a
            single-shot task that waits 30 s (so M5 init, Wi-Fi, BLE, the
            speaker arpeggio, and demo_loop's babble can all stabilise),
            then calls start_qr_scan(board). Decoded payloads end up in the
            serial log under the "qr" tag. Once the Phase 3 device_ui tab
            is in, this option goes away — the user will start/stop the
            scanner from the touchscreen.

endmenu
```

## sdkconfig.defaults.esp32s3
```kconfig
# M5Stack CoreS3 (ESP32-S3) specific defaults.

CONFIG_IDF_TARGET="esp32s3"
CONFIG_ESPTOOLPY_FLASHSIZE_16MB=y
CONFIG_ESPTOOLPY_FLASHSIZE="16MB"

# CoreS3 has 8 MB quad-SPI PSRAM. The avatar canvas (320*240*2 = 150 KB) lives there.
CONFIG_SPIRAM=y
CONFIG_SPIRAM_MODE_QUAD=y
CONFIG_SPIRAM_SPEED_80M=y
CONFIG_SPIRAM_USE_MALLOC=y
# NOTE: SPIRAM_MALLOC_ALWAYSINTERNAL is intentionally NOT set here. The
# value lives in the common sdkconfig.defaults (=1024) — this per-target
# file is loaded *after* it in the SDKCONFIG_DEFAULTS chain, so setting it
# here would silently override the common value. A stale 16384 here was
# exactly that bug: local builds (whose persisted sdkconfig had 1024)
# worked, but fresh CI builds got 16384 and the esp-aes DMA alloc failed
# during TLS reconnects. Keep memory tuning in the common file only.

# Default console on the on-board USB-Serial-JTAG.
CONFIG_ESP_CONSOLE_USB_SERIAL_JTAG=y
```

## sdkconfig.defaults.stopwatch
```kconfig
# M5Stack StopWatch (C152) — 1.75" AMOLED 円形 + ES8311 + MEMS MIC + M5PM1
# PMIC + M5IOE1 IO expander + RX8130CE RTC + BMI270 IMU + 振動モータ.
# Selected by `make build BOARD=stopwatch`.
#
# ESP32-S3R8 module: 16 MB external SPI flash + 8 MB in-package Octal PSRAM
# (the `R8` suffix is the Octal-PSRAM variant). M5Unified ≥ 0.2.17 / M5GFX
# ≥ 0.2.23 handle Panel_CO5300 autodetect, M5PM1 power backend, RX8130CE RTC
# and the ES8311 speaker/mic enable callbacks — so as long as we land here
# with the right PSRAM mode + flash size, `M5.begin()` brings up the AMOLED
# / touch / audio stack on its own.
CONFIG_SPIRAM_MODE_OCT=y
CONFIG_SPIRAM_SPEED_80M=y
CONFIG_ESPTOOLPY_FLASHSIZE_16MB=y
CONFIG_ESPTOOLPY_FLASHSIZE="16MB"

# Free UART0 (G43 TX / G44 RX) for the back-side 2.54 mm bus — it's the only
# UART exposed there, so anything wanting to drive an external SCS bus or
# console-via-3.3V from the back will route through it. Push the ESP-IDF
# console + idf.py monitor onto USB-Serial-JTAG instead so the two can't
# fight over UART0 pins.
CONFIG_ESP_CONSOLE_USB_SERIAL_JTAG=y
# UART0 stays unconfigured here; sub-components opt in via their own pin
# selection (e.g. scs_servo in a future Phase 3 servo-enable path).

# StopWatch has no DVP camera. Make sure CONFIG_STACKCHAN_CAMERA_ENABLED
# stays off (the cores3 profile is the only one that flips it to y).
CONFIG_STACKCHAN_CAMERA_ENABLED=n
```
